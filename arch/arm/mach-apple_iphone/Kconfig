## arch/arm/mach-apple_iphone/Kconfig
```kconfig
menu "Apple iPhone platform type"
	depends on MACH_APPLE_IPHONE

choice
	prompt "Model"
	default IPHONE_2G

config IPHONE_2G
	bool "iPhone 2G"
	help
	  Select this option if the device is an iPhone 2G.

config IPHONE_3G
	bool "iPhone 3G"
	help
	  Select this option if the device is an iPhone 3G.

config IPODTOUCH_1G
	bool "iPod touch 1G"
	help
	  Select this option if the device is an iPod touch 1G.

endchoice

config IPHONE_PMU
	bool "iPhone PMU Driver (obsolete)"
	default n
	help
		Select this option to enable the obsolete PMU driver.

config IPHONE_BATTERY
	bool "iPhone Battery Driver"
	depends on IPHONE_PMU
	help
		Select this option to enable the iPhone battery support with the PMU.

config IPHONE_BACKLIGHT
	bool "iPhone Backlight Driver"
	depends on IPHONE_PMU && BACKLIGHT_CLASS_DEVICE
	help
		Select this option to enable the iPhone backlight driver.

endmenu
```

## arch/arm/mach-s5l8900/Kconfig
```kconfig
menu "S5L8900"
	depends on ARCH_S5L8900
	select POWER_PCF50633
	help
		Support for S5L8900 Chips found in the iPhone, iPhone 3G and iPod Touch 1G
		
choice
	prompt "Model"
	default IPHONE_3G

config IPHONE_2G
	bool "iPhone 2G"
	help
	  Say Y here if you are using the original iPhone.

config IPHONE_3G
	bool "iPhone 3G"
	help
	  Say Y here if you are using the iPhone 3G.

config IPODTOUCH_1G
	bool "iPod touch 1G"
	help
	  Say Y here if you are using the iPod touch 1G.

endchoice

endmenu
```

## drivers/gpu/mbx/Kconfig
```kconfig
#
# Drm device configuration
#
# This driver provides support for the
# Direct Rendering Infrastructure (DRI) in XFree86 4.1.0 and higher.
#
menuconfig IPHONE_MBX
        tristate "PowerVR MBX Kernel Driver"
        depends on (IPHONE_2G || IPHONE_3G)
```
